AUTOSAR XML (schema 19-11)
standard types defined: Float32
package /Components
  application sw component type SensorComponent: category=APPLICATION_LAYER
    provide port TemperatureOutput: provided-interface=TemperatureInterface
package /Interfaces
  sender receiver interface TemperatureInterface
    data TempValue: type=Float32
